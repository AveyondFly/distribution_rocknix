// SPDX-License-Identifier: (GPL-2.0+ OR MIT)
/*
* # Copyright (C) 2022-26 AURKNIX (https://github.com/AveyondFly)
*/

/dts-v1/;
#include "rk3326-gameconsole-r36s.dts"

/ {
	model = "Anbernic RG351V";
	compatible = "anbernic,rg351v", "rockchip,rk3326";
};

&internal_display {
	compatible = "rocknix,generic-dsi";
	panel_description =
	"G size=52,70 delays=20,96,20,120,20 format=rgb888 lanes=4 flags=0xe03",
	
	"M clock=50000 horizontal=640,450,46,450 vertical=480,17,5,13 default=1",
	"M clock=50000 horizontal=640,450,85,450 vertical=480,17,106,13",
	"M clock=50000 horizontal=640,450,60,450 vertical=480,17,115,13",
	"M clock=50010 horizontal=640,450,73,450 vertical=480,17,110,13",
	"M clock=50140 horizontal=640,450,60,450 vertical=480,17,35,13",
	"M clock=55870 horizontal=640,450,59,450 vertical=480,17,75,13",
	"M clock=50400 horizontal=640,450,77,450 vertical=480,17,10,13",
	"M clock=50310 horizontal=640,450,85,450 vertical=480,17,6,13",
	"M clock=54600 horizontal=640,450,94,450 vertical=480,17,46,13",
	"M clock=75470 horizontal=640,450,60,450 vertical=480,17,115,13",
	"M clock=74160 horizontal=640,450,60,450 vertical=480,17,5,13",
	"M clock=98880 horizontal=640,450,60,450 vertical=480,17,5,13",
	
	"I seq=b9f11283",
	"I seq=b1000000da80",
	"I seq=b2001370",
	"I seq=b31010282803ff00000000",
	"I seq=b480",
	"I seq=b50a0a",
	"I seq=b67f7f",
	"I seq=b82662f063",
	"I seq=ba338105f90e0e2000000000000000442500900a0000014f01000037",
	"I seq=bc47",
	"I seq=bf021100",
	"I seq=c0737350500000125000",
	"I seq=c153c0323277e1dddd77773333",
	"I seq=c68200bfff00ff",
	"I seq=c7b8000a000000",
	"I seq=c810401e02",
	"I seq=cc0b",
	"I seq=e000070d37353f4144060c0d0f111012141a00070d37353f4144060c0d0f111012141a",
	"I seq=e307070b0b0b0b00000000ff00c010",
	"I seq=e9c810020000b0b11131232880b0b127080004020000000004020000008888ba60240888888888888888ba713518888888888800000001000000000000000000",
	"I seq=ea970a820203070000000000008188ba17538888888888888088ba0642888888888888230000028000000000000000000000000000000000000000000000",
	"I seq=efffff01",
	"I seq=11 wait=200",
	"I seq=29 wait=50";
};
