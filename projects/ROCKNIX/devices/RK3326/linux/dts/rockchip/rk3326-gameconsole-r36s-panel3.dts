// SPDX-License-Identifier: (GPL-2.0+ OR MIT)
/*
* # Copyright (C) 2022-26 AURKNIX (https://github.com/AveyondFly)
*/

/dts-v1/;
#include "rk3326-gameconsole-r36s.dts"

/ {
	model = "Game Console R36S Panel3";
	compatible = "gameconsole,r35s", "gameconsole,r36s", "rockchip,rk3326";
};

&cru {
	assigned-clock-rates = <1189000000>,
	<200000000>, <200000000>,
	<150000000>, <150000000>,
	<100000000>, <200000000>;
};

&internal_display {
	compatible = "rocknix,generic-dsi";
	panel_description = 
	"G size=52,70 delays=20,150,20,120,20 format=rgb888 lanes=4 flags=0xe03",

	"M clock=29000 horizontal=640,150,4,150 vertical=480,16,2,14 default=1",
	
	"I seq=ff30",
	"I seq=ff52",
	"I seq=ff01",
	"I seq=e300",
	"I seq=0400",
	"I seq=0503",
	"I seq=2412",
	"I seq=251e",
	"I seq=266f",
	"I seq=2752",
	"I seq=2867",
	"I seq=2901",
	"I seq=2adf",
	"I seq=379c",
	"I seq=38a7",
	"I seq=3953",
	"I seq=4400",
	"I seq=493c",
	"I seq=59fe",
	"I seq=5c00",
	"I seq=8020",
	"I seq=9177",
	"I seq=9277",
	"I seq=a055",
	"I seq=a150",
	"I seq=a49c",
	"I seq=a702",
	"I seq=a801",
	"I seq=a921",
	"I seq=aafc",
	"I seq=ab28",
	"I seq=ac06",
	"I seq=ad06",
	"I seq=ae06",
	"I seq=af03",
	"I seq=b008",
	"I seq=b126",
	"I seq=b228",
	"I seq=b328",
	"I seq=b433",
	"I seq=b508",
	"I seq=b626",
	"I seq=b708",
	"I seq=b826",
	"I seq=c000",
	"I seq=c100",
	"I seq=c200",
	"I seq=ff30",
	"I seq=ff52",
	"I seq=ff02",
	"I seq=b00b",
	"I seq=b116",
	"I seq=b217",
	"I seq=b32c",
	"I seq=b432",
	"I seq=b53b",
	"I seq=b629",
	"I seq=b740",
	"I seq=b80d",
	"I seq=b905",
	"I seq=ba12",
	"I seq=bb10",
	"I seq=bc12",
	"I seq=bd15",
	"I seq=be19",
	"I seq=bf0e",
	"I seq=c016",
	"I seq=c10a",
	"I seq=d00c",
	"I seq=d117",
	"I seq=d214",
	"I seq=d32e",
	"I seq=d432",
	"I seq=d53c",
	"I seq=d622",
	"I seq=d73d",
	"I seq=d80d",
	"I seq=d907",
	"I seq=da13",
	"I seq=db13",
	"I seq=dc11",
	"I seq=dd15",
	"I seq=de19",
	"I seq=df10",
	"I seq=e017",
	"I seq=e10a",
	"I seq=ff30",
	"I seq=ff52",
	"I seq=ff03",
	"I seq=002a",
	"I seq=012a",
	"I seq=022a",
	"I seq=032a",
	"I seq=0461",
	"I seq=0580",
	"I seq=06c7",
	"I seq=0701",
	"I seq=0882",
	"I seq=0983",
	"I seq=302a",
	"I seq=312a",
	"I seq=322a",
	"I seq=332a",
	"I seq=34a1",
	"I seq=35c5",
	"I seq=3680",
	"I seq=3723",
	"I seq=4082",
	"I seq=4183",
	"I seq=4280",
	"I seq=4381",
	"I seq=4455",
	"I seq=45e6",
	"I seq=46e5",
	"I seq=4755",
	"I seq=48e8",
	"I seq=49e7",
	"I seq=5002",
	"I seq=5101",
	"I seq=5204",
	"I seq=5303",
	"I seq=5455",
	"I seq=55ea",
	"I seq=56e9",
	"I seq=5755",
	"I seq=58ec",
	"I seq=59eb",
	"I seq=7e02",
	"I seq=7f80",
	"I seq=e05a",
	"I seq=b100",
	"I seq=b40e",
	"I seq=b50f",
	"I seq=b604",
	"I seq=b707",
	"I seq=b806",
	"I seq=b905",
	"I seq=ba0f",
	"I seq=c700",
	"I seq=ca0e",
	"I seq=cb0f",
	"I seq=cc04",
	"I seq=cd07",
	"I seq=ce06",
	"I seq=cf05",
	"I seq=d00f",
	"I seq=810f",
	"I seq=840e",
	"I seq=850f",
	"I seq=8607",
	"I seq=8704",
	"I seq=8805",
	"I seq=8906",
	"I seq=8a00",
	"I seq=970f",
	"I seq=9a0e",
	"I seq=9b0f",
	"I seq=9c07",
	"I seq=9d04",
	"I seq=9e05",
	"I seq=9f06",
	"I seq=a000",
	"I seq=ff30",
	"I seq=ff52",
	"I seq=ff02",
	"I seq=0101",
	"I seq=02da",
	"I seq=03ba",
	"I seq=04a8",
	"I seq=059a",
	"I seq=0670",
	"I seq=07ff",
	"I seq=0891",
	"I seq=0990",
	"I seq=0aff",
	"I seq=0b8f",
	"I seq=0c60",
	"I seq=0d58",
	"I seq=0e48",
	"I seq=0f38",
	"I seq=102b",
	"I seq=ff30",
	"I seq=ff52",
	"I seq=ff00",
	"I seq=3602",
	"I seq=3a70",
	"I seq=11 wait=200",
	"I seq=29 wait=20";
};
