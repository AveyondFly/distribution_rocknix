// SPDX-License-Identifier: (GPL-2.0+ OR MIT)
/*
* # Copyright (C) 2022-26 AURKNIX (https://github.com/AveyondFly)
*/

/dts-v1/;
#include "rk3326-gameconsole-r36s.dts"

/ {
	model = "Game Console R36sPlus";
	compatible = "gameconsole,r36splus", "rockchip,rk3326";
};

&internal_display {
	compatible = "rocknix,generic-dsi";
	panel_description = 
	"G size=153,85 delays=20,20,20,120,20 format=rgb888 lanes=4 flags=0xe03",
	
	"M clock=36000 horizontal=720,45,4,31 vertical=720,15,3,12 default=1",

	"I seq=11 wait=250",
	"I seq=b9f11283",
	"I seq=ba338105f90e0e2000000000000000442500900a0000014f01000037",
	"I seq=b82522f063",
	"I seq=bf021100",
	"I seq=b31010282803ff00000000",
	"I seq=c0737350500000127000",
	"I seq=bc46",
	"I seq=cc0b",
	"I seq=b480",
	"I seq=b23c1230",
	"I seq=e307070b0b030b00000000ff00c010",
	"I seq=c13600323277f1cccc77773333",
	"I seq=b50a0a",
	"I seq=b68888",
	"I seq=e9c8100a100fa1801231234786a180470800000d00000000000d00000048028baf4602888888888848138baf5713888888888800000000000000000000000000",
	"I seq=ea9612010101780200000000004f318ba8317588888888884f208ba820648888888888230000010200000000000000000000000000000040a18000000000",
	"I seq=e0000a0f293b3f4239060d10131514151017000a0f293b3f4239060d10131514151017",
	"I seq=29 wait=50";
};
