// SPDX-License-Identifier: (GPL-2.0+ OR MIT)
/*
* # Copyright (C) 2022-26 AURKNIX (https://github.com/AveyondFly)
*/

#include "rk3326-xifan-xf35h.dts"

/ {
	model = "XiFan RF35H";
	compatible = "xifan,rf35h", "rockchip,rk3326";
};
