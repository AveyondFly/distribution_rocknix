// SPDX-License-Identifier: (GPL-2.0+ OR MIT)
/*
* # Copyright (C) 2022-26 AURKNIX (https://github.com/AveyondFly)
*/

#include "rk3326-xifan-r36max2.dts"

/ {
	model = "XiFan RF45V";
	compatible = "xifan,rf45v", "rockchip,rk3326";
};
