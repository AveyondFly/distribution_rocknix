// SPDX-License-Identifier: (GPL-2.0+ OR MIT)
/*
 * AISLPC RG43H Pro v1 - RK915 WiFi variant.
 *
 * Inherits the dArkOS RG43H Pro device tree and only changes the WiFi
 * chip type used by the Rockchip wlan platform data.
 */

#include "rk3562-rg43h.dts"

/ {
	compatible = "aislpc,rg43h-pro-v1", "aislpc,rg43h-pro", "rockchip,rk3562";
};

&{/wireless-wlan} {
	wifi_chip_type = "rk915";
};
