// SPDX-License-Identifier: (GPL-2.0+ OR MIT)
/*
 * AISLPC RG52 Mini v1 - RK915 WiFi variant.
 *
 * This inherits the dArkOS RG52 Mini device tree and only changes the WiFi
 * chip type used by the Rockchip wlan platform data.
 */

#include "rk3562-rg52mini.dts"

/ {
	compatible = "aislpc,rg52mini-v1", "aislpc,rg52mini", "rockchip,rk3562";
};

&{/wireless-wlan} {
	wifi_chip_type = "rk915";
};
